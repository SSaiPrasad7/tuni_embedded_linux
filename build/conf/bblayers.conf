## build/conf/bblayers.conf
```bitbake
# POKY_BBLAYERS_CONF_VERSION is increased each time build/conf/bblayers.conf
# changes incompatibly
POKY_BBLAYERS_CONF_VERSION = "2"

BBPATH = "${TOPDIR}"
BBFILES ?= ""

BBLAYERS ?= " \
  /home/student/13/poky/meta \
  /home/student/13/poky/meta-poky \
  /home/student/13/poky/meta-yocto-bsp \
  /home/student/13/meta-pynq \
  /home/student/13/meta-xilinx/meta-xilinx-bsp \
  /home/student/13/meta-xilinx/meta-xilinx-contrib \
  "
```

## conf/bblayers.conf
```bitbake
# POKY_BBLAYERS_CONF_VERSION is increased each time build/conf/bblayers.conf
# changes incompatibly
POKY_BBLAYERS_CONF_VERSION = "2"

BBPATH = "${TOPDIR}"
BBFILES ?= ""

BBLAYERS ?= " \
  /home/student/13/poky/meta \
  /home/student/13/poky/meta-poky \
  /home/student/13/poky/meta-yocto-bsp \
  "
```

## meta-group13/conf/layer.conf
```bitbake
# We have a conf and classes directory, add to BBPATH
BBPATH .= ":${LAYERDIR}"

# We have recipes-* directories, add to BBFILES
BBFILES += "${LAYERDIR}/recipes-*/*/*.bb \
            ${LAYERDIR}/recipes-*/*/*.bbappend"

BBFILE_COLLECTIONS += "meta-group13"
BBFILE_PATTERN_meta-group13  = "^${LAYERDIR}/"
BBFILE_PRIORITY_meta-group13 = "6"
```

## meta-hello-world/conf/layer.conf
```bitbake
# We have a conf and classes directory, add to BBPATH
BBPATH .= ":${LAYERDIR}"

# We have recipes-* directories, add to BBFILES
BBFILES += "${LAYERDIR}/recipes-*/*/*.bb \
            ${LAYERDIR}/recipes-*/*/*.bbappend"

BBFILE_COLLECTIONS += "../meta-hello-world"
BBFILE_PATTERN_../meta-hello-world = "^${LAYERDIR}/"
BBFILE_PRIORITY_../meta-hello-world = "5"
```
